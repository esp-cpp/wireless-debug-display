## main/Kconfig.projbuild
```kconfig
menu "Wireless Debug Display Configuration"

    choice
        prompt "Hardware Configuration"
        default HARDWARE_BOX
        help
            Select the dev-kit / hardware you're using.
        config HARDWARE_WROVER_KIT
            depends on IDF_TARGET_ESP32
            bool "ESP32 WROVER KIT V4"
        config HARDWARE_BOX
            depends on IDF_TARGET_ESP32S3
            bool "ESP BOX (ESP32-S3-BOX or ESP32-S3-BOX-3)"
        config HARDWARE_TDECK
            depends on IDF_TARGET_ESP32S3
            bool "LILYGO T DECK"
    endchoice

    config DEBUG_SERVER_PORT
        int "Debug Display Server Port"
        default 5555
        help
            The port number of the wireless debug display's udp server

    config ESP_WIFI_SSID
        string "WiFi SSID"
        default ""
        help
            SSID (network name) for the wireless debug display to connect to.

    config ESP_WIFI_PASSWORD
        string "WiFi Password"
        default ""
        help
            WiFi password (WPA or WPA2) for the wireless debug display to use.

    config ESP_MAXIMUM_RETRY
        int "Maximum retry"
        default 5
        help
            Set the Maximum retry to avoid station reconnecting to the AP unlimited when the AP is really inexistent.

endmenu
```

## sdkconfig.defaults
```kconfig
# TODO: uncomment one of these if you want to support a specifc target by default
# CONFIG_IDF_TARGET="esp32"
# CONFIG_IDF_TARGET="esp32s2"
# CONFIG_IDF_TARGET="esp32s3"
# CONFIG_IDF_TARGET="esp32c3"

# TODO: uncomment if you want freertos to run at 1 khz instead of the default 100 hz
CONFIG_FREERTOS_HZ=1000

# TODO: uncomment if you want to run the esp at max clock speed (240 mhz)
# ESP32-specific
#
CONFIG_ESP_DEFAULT_CPU_FREQ_MHZ_240=y
CONFIG_ESP_DEFAULT_CPU_FREQ_MHZ=240

# TODO: uncomment if you want to update the event and main task stask sizes
# Common ESP-related
#
CONFIG_ESP_SYSTEM_EVENT_TASK_STACK_SIZE=4096
CONFIG_ESP_MAIN_TASK_STACK_SIZE=8192

# TODO: uncomment if you want to enable exceptions (which may be needed by certain components such as cli)
# CONFIG_COMPILER_CXX_EXCEPTIONS=y

CONFIG_ESPTOOLPY_FLASHSIZE_4MB=y
CONFIG_ESPTOOLPY_FLASHSIZE="4MB"

#
# Partition Table
#
CONFIG_PARTITION_TABLE_CUSTOM=y
CONFIG_PARTITION_TABLE_CUSTOM_FILENAME="partitions.csv"

#
# LVGL configuration - # Color settings
#
# CONFIG_LV_COLOR_DEPTH_32 is not set
CONFIG_LV_COLOR_DEPTH_16=y
# CONFIG_LV_COLOR_DEPTH_8 is not set
# CONFIG_LV_COLOR_DEPTH_1 is not set
CONFIG_LV_COLOR_DEPTH=16
CONFIG_LV_COLOR_16_SWAP=y
CONFIG_LV_COLOR_MIX_ROUND_OFS=128
CONFIG_LV_COLOR_CHROMA_KEY_HEX=0x00FF00

#
# LVGL configuration - # Themes
#
CONFIG_LV_USE_THEME_DEFAULT=y
CONFIG_LV_THEME_DEFAULT_DARK=y
CONFIG_LV_THEME_DEFAULT_GROW=y
CONFIG_LV_THEME_DEFAULT_TRANSITION_TIME=80
```
